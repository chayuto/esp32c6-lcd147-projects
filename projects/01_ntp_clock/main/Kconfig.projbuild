## projects/01_ntp_clock/main/Kconfig.projbuild
```kconfig
menu "NTP Clock Configuration"

    config WIFI_SSID
        string "WiFi SSID"
        default "your_ssid"
        help
            SSID of the WiFi network to connect to.

    config WIFI_PASSWORD
        string "WiFi Password"
        default "your_password"
        help
            Password of the WiFi network.

    config WIFI_CONNECT_TIMEOUT_MS
        int "WiFi connect timeout (ms)"
        default 15000
        help
            Maximum time to wait for WiFi connection.

    config NTP_SERVER
        string "NTP Server"
        default "pool.ntp.org"
        help
            Primary NTP server hostname.

    choice TIMEZONE_REGION
        prompt "Timezone"
        default TIMEZONE_SYDNEY
        help
            Select your timezone. DST transitions are handled automatically
            for regions that observe daylight saving time.
            For unlisted regions, choose Custom and set CONFIG_TIMEZONE_POSIX
            directly in sdkconfig.defaults.

        config TIMEZONE_UTC
            bool "UTC"
        config TIMEZONE_DUBAI
            bool "Asia/Dubai (GST, UTC+4) — UAE, Oman"
        config TIMEZONE_KOLKATA
            bool "Asia/Kolkata (IST, UTC+5:30) — India, Sri Lanka"
        config TIMEZONE_BANGKOK
            bool "Asia/Bangkok (ICT, UTC+7) — Thailand, Vietnam, Indonesia West"
        config TIMEZONE_SINGAPORE
            bool "Asia/Singapore (SGT, UTC+8) — Singapore, Malaysia, Philippines"
        config TIMEZONE_SHANGHAI
            bool "Asia/Shanghai (CST, UTC+8) — China, Hong Kong, Taiwan"
        config TIMEZONE_TOKYO
            bool "Asia/Tokyo (JST, UTC+9) — Japan, South Korea"
        config TIMEZONE_SYDNEY
            bool "Australia/Sydney (AEST/AEDT, UTC+10/+11)"
        config TIMEZONE_AUCKLAND
            bool "Pacific/Auckland (NZST/NZDT, UTC+12/+13)"
        config TIMEZONE_MOSCOW
            bool "Europe/Moscow (MSK, UTC+3)"
        config TIMEZONE_LONDON
            bool "Europe/London (GMT/BST, UTC+0/+1)"
        config TIMEZONE_PARIS
            bool "Europe/Paris (CET/CEST, UTC+1/+2) — Central Europe"
        config TIMEZONE_NEW_YORK
            bool "America/New_York (EST/EDT, UTC-5/-4)"
        config TIMEZONE_CHICAGO
            bool "America/Chicago (CST/CDT, UTC-6/-5)"
        config TIMEZONE_DENVER
            bool "America/Denver (MST/MDT, UTC-7/-6)"
        config TIMEZONE_LOS_ANGELES
            bool "America/Los_Angeles (PST/PDT, UTC-8/-7)"
        config TIMEZONE_SAO_PAULO
            bool "America/Sao_Paulo (BRT, UTC-3)"
        config TIMEZONE_CUSTOM
            bool "Custom — set CONFIG_TIMEZONE_POSIX in sdkconfig.defaults"
    endchoice

    config TIMEZONE_POSIX
        string
        default "UTC0"                              if TIMEZONE_UTC
        default "GST-4"                             if TIMEZONE_DUBAI
        default "IST-5:30"                          if TIMEZONE_KOLKATA
        default "ICT-7"                             if TIMEZONE_BANGKOK
        default "SGT-8"                             if TIMEZONE_SINGAPORE
        default "CST-8"                             if TIMEZONE_SHANGHAI
        default "JST-9"                             if TIMEZONE_TOKYO
        default "AEST-10AEDT,M10.1.0,M4.1.0/3"    if TIMEZONE_SYDNEY
        default "NZST-12NZDT,M9.5.0,M4.1.0/3"     if TIMEZONE_AUCKLAND
        default "MSK-3"                             if TIMEZONE_MOSCOW
        default "GMT0BST,M3.5.0/1,M10.5.0"         if TIMEZONE_LONDON
        default "CET-1CEST,M3.5.0,M10.5.0/3"      if TIMEZONE_PARIS
        default "EST5EDT,M3.2.0,M11.1.0"           if TIMEZONE_NEW_YORK
        default "CST6CDT,M3.2.0,M11.1.0"           if TIMEZONE_CHICAGO
        default "MST7MDT,M3.2.0,M11.1.0"           if TIMEZONE_DENVER
        default "PST8PDT,M3.2.0,M11.1.0"           if TIMEZONE_LOS_ANGELES
        default "BRT3"                              if TIMEZONE_SAO_PAULO
        default "AEST-10AEDT,M10.1.0,M4.1.0/3"    if TIMEZONE_CUSTOM
        help
            POSIX timezone string auto-derived from Timezone selection above.
            For Custom: override this in sdkconfig.defaults, e.g.:
            CONFIG_TIMEZONE_POSIX="EST5EDT,M3.2.0,M11.1.0"

endmenu
```

## projects/01_ntp_clock/sdkconfig.defaults.template
```kconfig
# Copy this file to sdkconfig.defaults and fill in your values.
# sdkconfig.defaults is gitignored to protect credentials.

# Target
CONFIG_IDF_TARGET="esp32c6"

# Flash
CONFIG_ESPTOOLPY_FLASHSIZE_4MB=y
CONFIG_PARTITION_TABLE_CUSTOM=y
CONFIG_PARTITION_TABLE_CUSTOM_FILENAME="partitions.csv"

# WiFi credentials
CONFIG_WIFI_SSID="your_ssid"
CONFIG_WIFI_PASSWORD="your_password"

# Timezone — pick ONE region line, or use Custom for unlisted zones:
#   CONFIG_TIMEZONE_UTC=y
#   CONFIG_TIMEZONE_DUBAI=y          # UAE, Oman (UTC+4)
#   CONFIG_TIMEZONE_KOLKATA=y        # India, Sri Lanka (UTC+5:30)
#   CONFIG_TIMEZONE_BANGKOK=y        # Thailand, Vietnam (UTC+7)
#   CONFIG_TIMEZONE_SINGAPORE=y      # Singapore, Malaysia (UTC+8)
#   CONFIG_TIMEZONE_SHANGHAI=y       # China, HK, Taiwan (UTC+8)
#   CONFIG_TIMEZONE_TOKYO=y          # Japan, South Korea (UTC+9)
CONFIG_TIMEZONE_SYDNEY=y             # Australia/Sydney (UTC+10/+11)
#   CONFIG_TIMEZONE_AUCKLAND=y       # New Zealand (UTC+12/+13)
#   CONFIG_TIMEZONE_MOSCOW=y         # Moscow (UTC+3)
#   CONFIG_TIMEZONE_LONDON=y         # UK (UTC+0/+1)
#   CONFIG_TIMEZONE_PARIS=y          # Central Europe (UTC+1/+2)
#   CONFIG_TIMEZONE_NEW_YORK=y       # US Eastern (UTC-5/-4)
#   CONFIG_TIMEZONE_CHICAGO=y        # US Central (UTC-6/-5)
#   CONFIG_TIMEZONE_DENVER=y         # US Mountain (UTC-7/-6)
#   CONFIG_TIMEZONE_LOS_ANGELES=y    # US Pacific (UTC-8/-7)
#   CONFIG_TIMEZONE_SAO_PAULO=y      # Brazil (UTC-3)
#
# For unlisted zones — use Custom + raw POSIX string:
#   CONFIG_TIMEZONE_CUSTOM=y
#   CONFIG_TIMEZONE_POSIX="IST-5:30"   # example: India

# LVGL fonts
CONFIG_LV_FONT_MONTSERRAT_14=y
CONFIG_LV_FONT_MONTSERRAT_16=y
CONFIG_LV_FONT_MONTSERRAT_20=y
CONFIG_LV_FONT_MONTSERRAT_36=y

# LVGL memory
CONFIG_LV_MEM_SIZE_KILOBYTES=64

# Disable BT (not needed for this project)
CONFIG_BT_ENABLED=n
```

## projects/02_wifi_monitor/sdkconfig.defaults.template
```kconfig
# Target
CONFIG_IDF_TARGET="esp32c6"

# Flash / Partition
CONFIG_ESPTOOLPY_FLASHSIZE_4MB=y
CONFIG_PARTITION_TABLE_CUSTOM=y
CONFIG_PARTITION_TABLE_CUSTOM_FILENAME="partitions.csv"

# LVGL fonts
CONFIG_LV_FONT_MONTSERRAT_14=y
CONFIG_LV_FONT_MONTSERRAT_20=y
CONFIG_LV_FONT_MONTSERRAT_36=y

# LVGL memory
CONFIG_LV_MEM_SIZE_KILOBYTES=64

# Disable BT — not needed, saves ~50 KB flash + RAM
CONFIG_BT_ENABLED=n

# FreeRTOS — single core, 1 kHz tick for fine-grained timeouts
CONFIG_FREERTOS_HZ=1000
CONFIG_FREERTOS_UNICORE=y

# Wi-Fi RX buffers — increase for high-throughput promiscuous sniffing
CONFIG_ESP_WIFI_STATIC_RX_BUFFER_NUM=16
CONFIG_ESP_WIFI_DYNAMIC_RX_BUFFER_NUM=64
CONFIG_ESP_WIFI_RX_BA_WIN=32

# Watchdog — extend to 15s for burst processing without false resets
CONFIG_ESP_TASK_WDT_EN=y
CONFIG_ESP_TASK_WDT_TIMEOUT_S=15
```

## projects/11_mcp_server_display/main/Kconfig.projbuild
```kconfig
menu "MCP Canvas Configuration"

    config CANVAS_WIFI_SSID
        string "WiFi SSID"
        default "YOUR_SSID_HERE"
        help
            SSID of the Wi-Fi network to connect to.

    config CANVAS_WIFI_PASSWORD
        string "WiFi Password"
        default "YOUR_PASSWORD_HERE"
        help
            Password for the Wi-Fi network.

endmenu
```

## projects/11_mcp_server_display/sdkconfig.defaults.template
```kconfig
CONFIG_IDF_TARGET="esp32c6"

# Flash / Partition
CONFIG_ESPTOOLPY_FLASHSIZE_8MB=y
CONFIG_PARTITION_TABLE_CUSTOM=y
CONFIG_PARTITION_TABLE_CUSTOM_FILENAME="partitions.csv"

# LVGL fonts
CONFIG_LV_FONT_MONTSERRAT_14=y
CONFIG_LV_FONT_MONTSERRAT_20=y

# LVGL memory — canvas uses static BSS, pool only for small widget overhead
CONFIG_LV_MEM_SIZE_KILOBYTES=32

# Disable BT — saves ~50KB flash + ~30KB RAM
CONFIG_BT_ENABLED=n

# FreeRTOS
CONFIG_FREERTOS_HZ=1000
CONFIG_FREERTOS_UNICORE=y

# HTTP server — large enough for MCP JSON bodies
CONFIG_HTTPD_MAX_URI_LEN=512
CONFIG_HTTPD_MAX_REQ_HDR_LEN=512

# Watchdog — JPEG encode takes up to 150ms, give plenty of margin
CONFIG_ESP_TASK_WDT_TIMEOUT_S=15

# Wi-Fi credentials — copy this file to sdkconfig.defaults and fill in
CONFIG_CANVAS_WIFI_SSID="YOUR_SSID_HERE"
CONFIG_CANVAS_WIFI_PASSWORD="YOUR_PASSWORD_HERE"
```

## projects/12_mcp_gpio/main/Kconfig.projbuild
```kconfig
menu "MCP GPIO Configuration"

    config GPIO_WIFI_SSID
        string "WiFi SSID"
        default "YOUR_SSID_HERE"
        help
            SSID of the Wi-Fi network to connect to.

    config GPIO_WIFI_PASSWORD
        string "WiFi Password"
        default "YOUR_PASSWORD_HERE"
        help
            Password for the Wi-Fi network.

endmenu
```

## projects/12_mcp_gpio/sdkconfig.defaults.template
```kconfig
CONFIG_IDF_TARGET="esp32c6"

# Flash / Partition
CONFIG_ESPTOOLPY_FLASHSIZE_8MB=y
CONFIG_PARTITION_TABLE_CUSTOM=y
CONFIG_PARTITION_TABLE_CUSTOM_FILENAME="partitions.csv"

# LVGL fonts — Montserrat 14 only (no drawing, smaller flash footprint vs project 11)
CONFIG_LV_FONT_MONTSERRAT_14=y

# LVGL memory — table + small widgets only
CONFIG_LV_MEM_SIZE_KILOBYTES=16

# Disable BT — saves ~50KB flash + ~30KB RAM
CONFIG_BT_ENABLED=n

# FreeRTOS
CONFIG_FREERTOS_HZ=1000
CONFIG_FREERTOS_UNICORE=y

# HTTP server — MCP JSON bodies are small for GPIO (no JPEG)
CONFIG_HTTPD_MAX_URI_LEN=512
CONFIG_HTTPD_MAX_REQ_HDR_LEN=512

# Watchdog — GPIO ops are fast, 10s is plenty
CONFIG_ESP_TASK_WDT_TIMEOUT_S=10

# Wi-Fi credentials — copy this file to sdkconfig.defaults and fill in
CONFIG_GPIO_WIFI_SSID="YOUR_SSID_HERE"
CONFIG_GPIO_WIFI_PASSWORD="YOUR_PASSWORD_HERE"
```
